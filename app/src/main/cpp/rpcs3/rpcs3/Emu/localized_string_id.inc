



WRAP(INVALID),

WRAP(RSX_OVERLAYS_TROPHY_BRONZE),
WRAP(RSX_OVERLAYS_TROPHY_SILVER),
WRAP(RSX_OVERLAYS_TROPHY_GOLD),
WRAP(RSX_OVERLAYS_TROPHY_PLATINUM),
WRAP(RSX_OVERLAYS_COMPILING_SHADERS),
WRAP(RSX_OVERLAYS_COMPILING_PPU_MODULES),
WRAP(RSX_OVERLAYS_MSG_DIALOG_YES),
WRAP(RSX_OVERLAYS_MSG_DIALOG_NO),
WRAP(RSX_OVERLAYS_MSG_DIALOG_CANCEL),
WRAP(RSX_OVERLAYS_MSG_DIALOG_OK),
WRAP(RSX_OVERLAYS_SAVE_DIALOG_TITLE),
WRAP(RSX_OVERLAYS_SAVE_DIALOG_DELETE),
WRAP(RSX_OVERLAYS_SAVE_DIALOG_LOAD),
WRAP(RSX_OVERLAYS_SAVE_DIALOG_SAVE),
WRAP(RSX_OVERLAYS_OSK_DIALOG_ACCEPT),
WRAP(RSX_OVERLAYS_OSK_DIALOG_CANCEL),
WRAP(RSX_OVERLAYS_OSK_DIALOG_SPACE),
WRAP(RSX_OVERLAYS_OSK_DIALOG_BACKSPACE),
WRAP(RSX_OVERLAYS_OSK_DIALOG_SHIFT),
WRAP(RSX_OVERLAYS_OSK_DIALOG_ENTER_TEXT),
WRAP(RSX_OVERLAYS_OSK_DIALOG_ENTER_PASSWORD),
WRAP(RSX_OVERLAYS_MEDIA_DIALOG_TITLE),
WRAP(RSX_OVERLAYS_MEDIA_DIALOG_TITLE_PHOTO_IMPORT),
WRAP(RSX_OVERLAYS_MEDIA_DIALOG_EMPTY),
WRAP(RSX_OVERLAYS_LIST_SELECT),
WRAP(RSX_OVERLAYS_LIST_CANCEL),
WRAP(RSX_OVERLAYS_LIST_DENY),
WRAP(RSX_OVERLAYS_PRESSURE_INTENSITY_TOGGLED_OFF),
WRAP(RSX_OVERLAYS_PRESSURE_INTENSITY_TOGGLED_ON),
WRAP(RSX_OVERLAYS_ANALOG_LIMITER_TOGGLED_OFF),
WRAP(RSX_OVERLAYS_ANALOG_LIMITER_TOGGLED_ON),
WRAP(RSX_OVERLAYS_MOUSE_AND_KEYBOARD_EMULATED),
WRAP(RSX_OVERLAYS_MOUSE_AND_KEYBOARD_PAD),

WRAP(CELL_GAME_ERROR_BROKEN_GAMEDATA),
WRAP(CELL_GAME_ERROR_BROKEN_HDDGAME),
WRAP(CELL_GAME_ERROR_BROKEN_EXIT_GAMEDATA),
WRAP(CELL_GAME_ERROR_BROKEN_EXIT_HDDGAME),
WRAP(CELL_GAME_ERROR_NOSPACE),
WRAP(CELL_GAME_ERROR_NOSPACE_EXIT),
WRAP(CELL_GAME_ERROR_DIR_NAME),
WRAP(CELL_GAME_DATA_EXIT_BROKEN),
WRAP(CELL_HDD_GAME_EXIT_BROKEN),

WRAP(CELL_HDD_GAME_CHECK_NOSPACE),
WRAP(CELL_HDD_GAME_CHECK_BROKEN),
WRAP(CELL_HDD_GAME_CHECK_NODATA),
WRAP(CELL_HDD_GAME_CHECK_INVALID),

WRAP(CELL_GAMEDATA_CHECK_NOSPACE),
WRAP(CELL_GAMEDATA_CHECK_BROKEN),
WRAP(CELL_GAMEDATA_CHECK_NODATA),
WRAP(CELL_GAMEDATA_CHECK_INVALID),

WRAP(CELL_MSG_DIALOG_ERROR_DEFAULT),
WRAP(CELL_MSG_DIALOG_ERROR_80010001),
WRAP(CELL_MSG_DIALOG_ERROR_80010002),
WRAP(CELL_MSG_DIALOG_ERROR_80010003),
WRAP(CELL_MSG_DIALOG_ERROR_80010004),
WRAP(CELL_MSG_DIALOG_ERROR_80010005),
WRAP(CELL_MSG_DIALOG_ERROR_80010006),
WRAP(CELL_MSG_DIALOG_ERROR_80010007),
WRAP(CELL_MSG_DIALOG_ERROR_80010008),
WRAP(CELL_MSG_DIALOG_ERROR_80010009),
WRAP(CELL_MSG_DIALOG_ERROR_8001000A),
WRAP(CELL_MSG_DIALOG_ERROR_8001000B),
WRAP(CELL_MSG_DIALOG_ERROR_8001000C),
WRAP(CELL_MSG_DIALOG_ERROR_8001000D),
WRAP(CELL_MSG_DIALOG_ERROR_8001000F),
WRAP(CELL_MSG_DIALOG_ERROR_80010010),
WRAP(CELL_MSG_DIALOG_ERROR_80010011),
WRAP(CELL_MSG_DIALOG_ERROR_80010012),
WRAP(CELL_MSG_DIALOG_ERROR_80010013),
WRAP(CELL_MSG_DIALOG_ERROR_80010014),
WRAP(CELL_MSG_DIALOG_ERROR_80010015),
WRAP(CELL_MSG_DIALOG_ERROR_80010016),
WRAP(CELL_MSG_DIALOG_ERROR_80010017),
WRAP(CELL_MSG_DIALOG_ERROR_80010018),
WRAP(CELL_MSG_DIALOG_ERROR_80010019),
WRAP(CELL_MSG_DIALOG_ERROR_8001001A),
WRAP(CELL_MSG_DIALOG_ERROR_8001001B),
WRAP(CELL_MSG_DIALOG_ERROR_8001001C),
WRAP(CELL_MSG_DIALOG_ERROR_8001001D),
WRAP(CELL_MSG_DIALOG_ERROR_8001001E),
WRAP(CELL_MSG_DIALOG_ERROR_8001001F),
WRAP(CELL_MSG_DIALOG_ERROR_80010020),
WRAP(CELL_MSG_DIALOG_ERROR_80010021),
WRAP(CELL_MSG_DIALOG_ERROR_80010022),
WRAP(CELL_MSG_DIALOG_ERROR_80010023),
WRAP(CELL_MSG_DIALOG_ERROR_80010024),
WRAP(CELL_MSG_DIALOG_ERROR_80010025),
WRAP(CELL_MSG_DIALOG_ERROR_80010026),
WRAP(CELL_MSG_DIALOG_ERROR_80010027),
WRAP(CELL_MSG_DIALOG_ERROR_80010028),
WRAP(CELL_MSG_DIALOG_ERROR_80010029),
WRAP(CELL_MSG_DIALOG_ERROR_8001002A),
WRAP(CELL_MSG_DIALOG_ERROR_8001002B),
WRAP(CELL_MSG_DIALOG_ERROR_8001002C),
WRAP(CELL_MSG_DIALOG_ERROR_8001002D),
WRAP(CELL_MSG_DIALOG_ERROR_8001002E),
WRAP(CELL_MSG_DIALOG_ERROR_8001002F),
WRAP(CELL_MSG_DIALOG_ERROR_80010030),
WRAP(CELL_MSG_DIALOG_ERROR_80010031),
WRAP(CELL_MSG_DIALOG_ERROR_80010032),
WRAP(CELL_MSG_DIALOG_ERROR_80010033),
WRAP(CELL_MSG_DIALOG_ERROR_80010034),
WRAP(CELL_MSG_DIALOG_ERROR_80010035),
WRAP(CELL_MSG_DIALOG_ERROR_80010036),
WRAP(CELL_MSG_DIALOG_ERROR_80010037),
WRAP(CELL_MSG_DIALOG_ERROR_80010038),
WRAP(CELL_MSG_DIALOG_ERROR_80010039),
WRAP(CELL_MSG_DIALOG_ERROR_8001003A),
WRAP(CELL_MSG_DIALOG_ERROR_8001003B),
WRAP(CELL_MSG_DIALOG_ERROR_8001003C),
WRAP(CELL_MSG_DIALOG_ERROR_8001003D),
WRAP(CELL_MSG_DIALOG_ERROR_8001003E),

WRAP(CELL_OSK_DIALOG_TITLE),
WRAP(CELL_OSK_DIALOG_BUSY),

WRAP(CELL_SAVEDATA_CB_BROKEN),
WRAP(CELL_SAVEDATA_CB_FAILURE),
WRAP(CELL_SAVEDATA_CB_NO_DATA),
WRAP(CELL_SAVEDATA_CB_NO_SPACE),
WRAP(CELL_SAVEDATA_NO_DATA),
WRAP(CELL_SAVEDATA_NEW_SAVED_DATA_TITLE),
WRAP(CELL_SAVEDATA_NEW_SAVED_DATA_SUB_TITLE),
WRAP(CELL_SAVEDATA_SAVE_CONFIRMATION),
WRAP(CELL_SAVEDATA_DELETE_CONFIRMATION),
WRAP(CELL_SAVEDATA_DELETE_SUCCESS),
WRAP(CELL_SAVEDATA_DELETE),
WRAP(CELL_SAVEDATA_SAVE),
WRAP(CELL_SAVEDATA_LOAD),
WRAP(CELL_SAVEDATA_OVERWRITE),
WRAP(CELL_SAVEDATA_AUTOSAVE),
WRAP(CELL_SAVEDATA_AUTOLOAD),

WRAP(CELL_CROSS_CONTROLLER_MSG),
WRAP(CELL_CROSS_CONTROLLER_FW_MSG),

WRAP(CELL_NP_RECVMESSAGE_DIALOG_TITLE),
WRAP(CELL_NP_RECVMESSAGE_DIALOG_TITLE_INVITE),
WRAP(CELL_NP_RECVMESSAGE_DIALOG_TITLE_ADD_FRIEND),
WRAP(CELL_NP_RECVMESSAGE_DIALOG_FROM),
WRAP(CELL_NP_RECVMESSAGE_DIALOG_SUBJECT),

WRAP(CELL_NP_SENDMESSAGE_DIALOG_TITLE),
WRAP(CELL_NP_SENDMESSAGE_DIALOG_TITLE_INVITE),
WRAP(CELL_NP_SENDMESSAGE_DIALOG_TITLE_ADD_FRIEND),
WRAP(CELL_NP_SENDMESSAGE_DIALOG_CONFIRMATION),
WRAP(CELL_NP_SENDMESSAGE_DIALOG_CONFIRMATION_INVITE),
WRAP(CELL_NP_SENDMESSAGE_DIALOG_CONFIRMATION_ADD_FRIEND),

WRAP(RECORDING_ABORTED),

WRAP(RPCN_NO_ERROR),
WRAP(RPCN_ERROR_INVALID_INPUT),
WRAP(RPCN_ERROR_WOLFSSL),
WRAP(RPCN_ERROR_RESOLVE),
WRAP(RPCN_ERROR_CONNECT),
WRAP(RPCN_ERROR_LOGIN_ERROR),
WRAP(RPCN_ERROR_ALREADY_LOGGED),
WRAP(RPCN_ERROR_INVALID_LOGIN),
WRAP(RPCN_ERROR_INVALID_PASSWORD),
WRAP(RPCN_ERROR_INVALID_TOKEN),
WRAP(RPCN_ERROR_INVALID_PROTOCOL_VERSION),
WRAP(RPCN_ERROR_UNKNOWN),
WRAP(RPCN_SUCCESS_LOGGED_ON),
WRAP(RPCN_FRIEND_REQUEST_RECEIVED),
WRAP(RPCN_FRIEND_ADDED),
WRAP(RPCN_FRIEND_LOST),
WRAP(RPCN_FRIEND_LOGGED_IN),
WRAP(RPCN_FRIEND_LOGGED_OUT),

WRAP(HOME_MENU_TITLE),
WRAP(HOME_MENU_EXIT_GAME),
WRAP(HOME_MENU_RESTART),
WRAP(HOME_MENU_RESUME),
WRAP(HOME_MENU_FRIENDS),
WRAP(HOME_MENU_FRIENDS_REQUESTS),
WRAP(HOME_MENU_FRIENDS_BLOCKED),
WRAP(HOME_MENU_FRIENDS_STATUS_ONLINE),
WRAP(HOME_MENU_FRIENDS_STATUS_OFFLINE),
WRAP(HOME_MENU_FRIENDS_STATUS_BLOCKED),
WRAP(HOME_MENU_FRIENDS_REQUEST_SENT),
WRAP(HOME_MENU_FRIENDS_REQUEST_RECEIVED),
WRAP(HOME_MENU_FRIENDS_BLOCK_USER_MSG),
WRAP(HOME_MENU_FRIENDS_UNBLOCK_USER_MSG),
WRAP(HOME_MENU_FRIENDS_REMOVE_USER_MSG),
WRAP(HOME_MENU_FRIENDS_ACCEPT_REQUEST_MSG),
WRAP(HOME_MENU_FRIENDS_CANCEL_REQUEST_MSG),
WRAP(HOME_MENU_FRIENDS_REJECT_REQUEST_MSG),
WRAP(HOME_MENU_FRIENDS_REJECT_REQUEST),
WRAP(HOME_MENU_FRIENDS_NEXT_LIST),
WRAP(HOME_MENU_SETTINGS),
WRAP(HOME_MENU_SETTINGS_SAVE),
WRAP(HOME_MENU_SETTINGS_SAVE_BUTTON),
WRAP(HOME_MENU_SETTINGS_DISCARD),
WRAP(HOME_MENU_SETTINGS_DISCARD_BUTTON),
WRAP(HOME_MENU_SETTINGS_AUDIO),
WRAP(HOME_MENU_SETTINGS_AUDIO_MASTER_VOLUME),
WRAP(HOME_MENU_SETTINGS_AUDIO_BACKEND),
WRAP(HOME_MENU_SETTINGS_AUDIO_BUFFERING),
WRAP(HOME_MENU_SETTINGS_AUDIO_BUFFER_DURATION),
WRAP(HOME_MENU_SETTINGS_AUDIO_TIME_STRETCHING),
WRAP(HOME_MENU_SETTINGS_AUDIO_TIME_STRETCHING_THRESHOLD),
WRAP(HOME_MENU_SETTINGS_VIDEO),
WRAP(HOME_MENU_SETTINGS_VIDEO_FRAME_LIMIT),
WRAP(HOME_MENU_SETTINGS_VIDEO_ANISOTROPIC_OVERRIDE),
WRAP(HOME_MENU_SETTINGS_VIDEO_OUTPUT_SCALING),
WRAP(HOME_MENU_SETTINGS_VIDEO_RCAS_SHARPENING),
WRAP(HOME_MENU_SETTINGS_VIDEO_STRETCH_TO_DISPLAY),
WRAP(HOME_MENU_SETTINGS_INPUT),
WRAP(HOME_MENU_SETTINGS_INPUT_BACKGROUND_INPUT),
WRAP(HOME_MENU_SETTINGS_INPUT_KEEP_PADS_CONNECTED),
WRAP(HOME_MENU_SETTINGS_INPUT_SHOW_PS_MOVE_CURSOR),
WRAP(HOME_MENU_SETTINGS_INPUT_CAMERA_FLIP),
WRAP(HOME_MENU_SETTINGS_INPUT_PAD_MODE),
WRAP(HOME_MENU_SETTINGS_INPUT_PAD_SLEEP),
WRAP(HOME_MENU_SETTINGS_INPUT_FAKE_MOVE_ROTATION_CONE_H),
WRAP(HOME_MENU_SETTINGS_INPUT_FAKE_MOVE_ROTATION_CONE_V),
WRAP(HOME_MENU_SETTINGS_ADVANCED),
WRAP(HOME_MENU_SETTINGS_ADVANCED_PREFERRED_SPU_THREADS),
WRAP(HOME_MENU_SETTINGS_ADVANCED_MAX_CPU_PREEMPTIONS),
WRAP(HOME_MENU_SETTINGS_ADVANCED_ACCURATE_RSX_RESERVATION_ACCESS),
WRAP(HOME_MENU_SETTINGS_ADVANCED_SLEEP_TIMERS_ACCURACY),
WRAP(HOME_MENU_SETTINGS_ADVANCED_MAX_SPURS_THREADS),
WRAP(HOME_MENU_SETTINGS_ADVANCED_DRIVER_WAKE_UP_DELAY),
WRAP(HOME_MENU_SETTINGS_ADVANCED_VBLANK_FREQUENCY),
WRAP(HOME_MENU_SETTINGS_ADVANCED_VBLANK_NTSC),
WRAP(HOME_MENU_SETTINGS_OVERLAYS),
WRAP(HOME_MENU_SETTINGS_OVERLAYS_SHOW_TROPHY_POPUPS),
WRAP(HOME_MENU_SETTINGS_OVERLAYS_SHOW_RPCN_POPUPS),
WRAP(HOME_MENU_SETTINGS_OVERLAYS_SHOW_SHADER_COMPILATION_HINT),
WRAP(HOME_MENU_SETTINGS_OVERLAYS_SHOW_PPU_COMPILATION_HINT),
WRAP(HOME_MENU_SETTINGS_OVERLAYS_SHOW_AUTO_SAVE_LOAD_HINT),
WRAP(HOME_MENU_SETTINGS_OVERLAYS_SHOW_PRESSURE_INTENSITY_TOGGLE_HINT),
WRAP(HOME_MENU_SETTINGS_OVERLAYS_SHOW_ANALOG_LIMITER_TOGGLE_HINT),
WRAP(HOME_MENU_SETTINGS_OVERLAYS_SHOW_MOUSE_AND_KB_TOGGLE_HINT),
WRAP(HOME_MENU_SETTINGS_PERFORMANCE_OVERLAY),
WRAP(HOME_MENU_SETTINGS_PERFORMANCE_OVERLAY_ENABLE),
WRAP(HOME_MENU_SETTINGS_PERFORMANCE_OVERLAY_ENABLE_FRAMERATE_GRAPH),
WRAP(HOME_MENU_SETTINGS_PERFORMANCE_OVERLAY_ENABLE_FRAMETIME_GRAPH),
WRAP(HOME_MENU_SETTINGS_PERFORMANCE_OVERLAY_DETAIL_LEVEL),
WRAP(HOME_MENU_SETTINGS_PERFORMANCE_OVERLAY_FRAMERATE_DETAIL_LEVEL),
WRAP(HOME_MENU_SETTINGS_PERFORMANCE_OVERLAY_FRAMETIME_DETAIL_LEVEL),
WRAP(HOME_MENU_SETTINGS_PERFORMANCE_OVERLAY_FRAMERATE_DATAPOINT_COUNT),
WRAP(HOME_MENU_SETTINGS_PERFORMANCE_OVERLAY_FRAMETIME_DATAPOINT_COUNT),
WRAP(HOME_MENU_SETTINGS_PERFORMANCE_OVERLAY_UPDATE_INTERVAL),
WRAP(HOME_MENU_SETTINGS_PERFORMANCE_OVERLAY_POSITION),
WRAP(HOME_MENU_SETTINGS_PERFORMANCE_OVERLAY_CENTER_X),
WRAP(HOME_MENU_SETTINGS_PERFORMANCE_OVERLAY_CENTER_Y),
WRAP(HOME_MENU_SETTINGS_PERFORMANCE_OVERLAY_MARGIN_X),
WRAP(HOME_MENU_SETTINGS_PERFORMANCE_OVERLAY_MARGIN_Y),
WRAP(HOME_MENU_SETTINGS_PERFORMANCE_OVERLAY_FONT_SIZE),
WRAP(HOME_MENU_SETTINGS_PERFORMANCE_OVERLAY_OPACITY),
WRAP(HOME_MENU_SETTINGS_DEBUG),
WRAP(HOME_MENU_SETTINGS_DEBUG_OVERLAY),
WRAP(HOME_MENU_SETTINGS_DEBUG_INPUT_OVERLAY),
WRAP(HOME_MENU_SETTINGS_DEBUG_DISABLE_VIDEO_OUTPUT),
WRAP(HOME_MENU_SETTINGS_DEBUG_TEXTURE_LOD_BIAS),
WRAP(HOME_MENU_SCREENSHOT),
WRAP(HOME_MENU_SAVESTATE),
WRAP(HOME_MENU_SAVESTATE_SAVE),
WRAP(HOME_MENU_SAVESTATE_AND_EXIT),
WRAP(HOME_MENU_RELOAD_SAVESTATE),
WRAP(HOME_MENU_RECORDING),
WRAP(HOME_MENU_TROPHIES),
WRAP(HOME_MENU_TROPHY_LIST_TITLE),
WRAP(HOME_MENU_TROPHY_LOCKED_TITLE),
WRAP(HOME_MENU_TROPHY_HIDDEN_TITLE),
WRAP(HOME_MENU_TROPHY_HIDDEN_DESCRIPTION),
WRAP(HOME_MENU_TROPHY_PLATINUM_RELEVANT),
WRAP(HOME_MENU_TROPHY_GRADE_BRONZE),
WRAP(HOME_MENU_TROPHY_GRADE_SILVER),
WRAP(HOME_MENU_TROPHY_GRADE_GOLD),
WRAP(HOME_MENU_TROPHY_GRADE_PLATINUM),

WRAP(PROGRESS_DIALOG_PROGRESS),
WRAP(PROGRESS_DIALOG_PROGRESS_ANALYZING),
WRAP(PROGRESS_DIALOG_REMAINING),
WRAP(PROGRESS_DIALOG_DONE),
WRAP(PROGRESS_DIALOG_FILE),
WRAP(PROGRESS_DIALOG_MODULE),
WRAP(PROGRESS_DIALOG_OF),
WRAP(PROGRESS_DIALOG_PLEASE_WAIT),
WRAP(PROGRESS_DIALOG_STOPPING_PLEASE_WAIT),
WRAP(PROGRESS_DIALOG_SCANNING_PPU_EXECUTABLE),
WRAP(PROGRESS_DIALOG_ANALYZING_PPU_EXECUTABLE),
WRAP(PROGRESS_DIALOG_SCANNING_PPU_MODULES),
WRAP(PROGRESS_DIALOG_LOADING_PPU_MODULES),
WRAP(PROGRESS_DIALOG_COMPILING_PPU_MODULES),
WRAP(PROGRESS_DIALOG_LINKING_PPU_MODULES),
WRAP(PROGRESS_DIALOG_APPLYING_PPU_CODE),
WRAP(PROGRESS_DIALOG_BUILDING_SPU_CACHE),
WRAP(PROGRESS_DIALOG_PRELOADING_SHADER_CACHE),

WRAP(EMULATION_PAUSED_RESUME_WITH_START),
WRAP(EMULATION_RESUMING),
WRAP(EMULATION_FROZEN),
WRAP(SAVESTATE_FAILED_DUE_TO_VDEC),
WRAP(SAVESTATE_FAILED_DUE_TO_SAVEDATA),
WRAP(SAVESTATE_FAILED_DUE_TO_SPU),
WRAP(SAVESTATE_FAILED_DUE_TO_MISSING_SPU_SETTING),
